## configs/gpu_defconfig
```kconfig
CONFIG_XNU_ARMCPU=y
CONFIG_XNU_ARMVIRT_PLATFORM=n
CONFIG_XNU_ARM_DT_PLATFORM=y
CONFIG_XNU_BOOT_PROGRESS=y
CONFIG_XNU_BUILD_ARCHIVES=y
CONFIG_XNU_DT_PANIC_REGION=n
CONFIG_XNU_EXTRA_LD_ARCHIVES="{tree}/build/adreno-link-stubs/libAdrenoLinkStubs.a"
CONFIG_XNU_NATIVE_ADRENO=y
CONFIG_XNU_NATIVE_LEGACY_DISPLAY=n
CONFIG_XNU_NATIVE_MOBILE_DISPLAY=n
CONFIG_XNU_NATIVE_RAM_BLOCK=n
CONFIG_XNU_NATIVE_UFS=n
CONFIG_XNU_NATIVE_VIRTIO_BLOCK=n
CONFIG_XNU_OWNER_BOOT_MANIFEST=n
CONFIG_XNU_OWNER_CACHE_MOUNT=n
CONFIG_XNU_OWNER_CACHE_STARTUP=n
CONFIG_XNU_OWNER_DATA_MOUNT=n
CONFIG_XNU_OWNER_DATA_VOLUME_UUID=n
CONFIG_XNU_OWNER_ROOT_AUDIT=n
CONFIG_XNU_OWNER_ROOT_TRUST=n
CONFIG_XNU_OWNER_UNION_SYSTEMOS=n
CONFIG_XNU_SHENG_PMGR=n
CONFIG_XNU_SOURCE_CORECRYPTO14=y
CONFIG_XNU_SOURCE_MOCKFS=n
CONFIG_XNU_SOURCE_PTHREAD=n
CONFIG_XNU_VERIFIED_ROOT_ARCHIVE=n
CONFIG_XNU_VERIFIED_ROOT_PROBE=n
CONFIG_XNU_ZONE_PGZ_ALIGNMENT_PROBE=n
CONFIG_XNU_CRYPTO_BOOTSTRAP="prelinked"
```
